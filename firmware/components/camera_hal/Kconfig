## firmware/components/camera_hal/Kconfig
```kconfig
menu "Camera HAL Configuration"
    config USE_MOCK_CAMERA
        bool "Use mock camera implementation"
        default y
endmenu
```

## firmware/components/wifi_prov/Kconfig
```kconfig
menu "WiFi Provisioning Configuration"
    config USE_REAL_WIFI_PROV
        bool "Use real WiFi/NVS/mDNS provisioning callbacks"
        default n
        help
            When enabled, uses real ESP-IDF WiFi, NVS, and mDNS APIs
            for provisioning. When disabled, mock callbacks that only
            log to stdout are used (suitable for QEMU testing).
endmenu
```

## firmware/sdkconfig.defaults
```kconfig
CONFIG_IDF_TARGET="esp32s3"
CONFIG_ESP_MAIN_TASK_STACK_SIZE=65536
CONFIG_MAIN_TASK_STACK_SIZE=65536
# CONFIG_ETH_USE_OPENETH is not set
CONFIG_USE_MOCK_CAMERA=n
CONFIG_USE_REAL_WIFI_PROV=y
CONFIG_SPIRAM=y
CONFIG_SPIRAM_MODE_OCT=y
CONFIG_SPIRAM_SPEED_80M=y
```

## firmware/sdkconfig.defaults.test
```kconfig
CONFIG_IDF_TARGET="esp32s3"
CONFIG_ESP_MAIN_TASK_STACK_SIZE=65536
CONFIG_MAIN_TASK_STACK_SIZE=65536
CONFIG_ETH_USE_OPENETH=y
CONFIG_USE_MOCK_CAMERA=y
# CONFIG_USE_REAL_WIFI_PROV is not set
```
